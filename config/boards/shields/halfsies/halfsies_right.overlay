/*
 * Copyright (c) 2020 The ZMK Contributors
 *
 * SPDX-License-Identifier: MIT
 */

#include "halfsies.dtsi"

&kscan0 {
	col-gpios
		= <&gpio0 11 GPIO_ACTIVE_HIGH>
		, <&gpio0 5  GPIO_ACTIVE_HIGH>
		, <&gpio0 4  GPIO_ACTIVE_HIGH>
		, <&gpio0 29 GPIO_ACTIVE_HIGH>
		, <&gpio1 28 GPIO_ACTIVE_HIGH>
		;
};