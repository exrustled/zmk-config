/*
 * Copyright (c) 2020 The ZMK Contributors
 *
 * SPDX-License-Identifier: MIT
 */

#include "halfsies.dtsi"

&kscan_faceup {
	input-gpios
	= <&gpio1 15 (GPIO_ACTIVE_LOW | GPIO_PULL_UP)>
	, <&gpio1 14 (GPIO_ACTIVE_LOW | GPIO_PULL_UP)>
	, <&gpio1 13 (GPIO_ACTIVE_LOW | GPIO_PULL_UP)>
	, <&gpio1 12 (GPIO_ACTIVE_LOW | GPIO_PULL_UP)>
	, <&gpio0 28 (GPIO_ACTIVE_LOW | GPIO_PULL_UP)>
	, <&gpio0 29 (GPIO_ACTIVE_LOW | GPIO_PULL_UP)>
	, <&gpio0 4  (GPIO_ACTIVE_LOW | GPIO_PULL_UP)>
	, <&gpio0 5  (GPIO_ACTIVE_LOW | GPIO_PULL_UP)>
	, <&gpio0 11 (GPIO_ACTIVE_LOW | GPIO_PULL_UP)>
	;
};

&kscan_facedown {
	input-gpios
	= <&gpio1 15 (GPIO_ACTIVE_LOW | GPIO_PULL_UP)>
	, <&gpio1 14 (GPIO_ACTIVE_LOW | GPIO_PULL_UP)>
	, <&gpio1 13 (GPIO_ACTIVE_LOW | GPIO_PULL_UP)>
	, <&gpio1 12 (GPIO_ACTIVE_LOW | GPIO_PULL_UP)>
	, <&gpio0 28 (GPIO_ACTIVE_LOW | GPIO_PULL_UP)>
	, <&gpio0 29 (GPIO_ACTIVE_LOW | GPIO_PULL_UP)>
	, <&gpio0 4  (GPIO_ACTIVE_LOW | GPIO_PULL_UP)>
	, <&gpio0 5  (GPIO_ACTIVE_LOW | GPIO_PULL_UP)>
	, <&gpio0 11 (GPIO_ACTIVE_LOW | GPIO_PULL_UP)>
	;
};
